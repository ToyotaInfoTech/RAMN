/*
 * ramn_sensors.c
 ******************************************************************************
 * @attention
 *
 * <h2><center>&copy; Copyright (c) 2021 TOYOTA MOTOR CORPORATION.
 * ALL RIGHTS RESERVED.</center></h2>
 *
 * This software component is licensed by TOYOTA MOTOR CORPORATION under BSD 3-Clause license,
 * the "License"; You may not use this file except in compliance with the
 * License. You may obtain a copy of the License at:
 *                        opensource.org/licenses/BSD-3-Clause
 *
 ******************************************************************************
 */

#include "ramn_sensors.h"

//Private --------------------------------------------



#if defined(EXPANSION_POWERTRAIN)

//variable to keep the tick of the last update.
static uint32_t last_update_tick = 0U;

RAMN_SENSORS_PowertrainSensors_t RAMN_SENSORS_POWERTRAIN_PREVIOUS = {
		.brake_pedal = 0U,
		.accel_pedal = 0U,
		.shift_lever = RAMN_LEVER_RELEASED,
		.gear = 0U
};
RAMN_SENSORS_PowertrainSensors_t RAMN_SENSORS_POWERTRAIN = {
		.brake_pedal = 0U,
		.accel_pedal = 0U,
		.shift_lever = RAMN_LEVER_RELEASED,
		.gear = 0U
};



static RAMN_LeverState_t convertLeverADC(uint16_t adcval)
{
	RAMN_LeverState_t         result = RAMN_LEVER_UNKNOWNSTATE;
	if      (adcval >= 0x0D00)  result = RAMN_LEVER_RELEASED;
	else if (adcval >= 0x0C00)  result = RAMN_LEVER_DOWN;
	else if (adcval >= 0x0B00)  result = RAMN_LEVER_RIGHT;
	else if (adcval >= 0x0A00)  result = RAMN_LEVER_LEFT;
	else if (adcval >= 0x0700)  result = RAMN_LEVER_PUSH;
	else if (adcval <= 0x0100)  result = RAMN_LEVER_UP;
	return result;
}

static void updatePowertrain(uint32_t tick)
{
	RAMN_SENSORS_POWERTRAIN.brake_pedal = RAMN_SENSORS_ADCValues[0];
	RAMN_SENSORS_POWERTRAIN.accel_pedal = RAMN_SENSORS_ADCValues[1];
	RAMN_SENSORS_POWERTRAIN.shift_lever = convertLeverADC(RAMN_SENSORS_ADCValues[2]);

	//Update the value, but only every 100ms to avoid flicker
	if (tick - last_update_tick > 100U )
	{

		last_update_tick = tick;
		if((RAMN_SENSORS_POWERTRAIN.shift_lever != RAMN_LEVER_RELEASED) && (RAMN_SENSORS_POWERTRAIN_PREVIOUS.shift_lever == RAMN_LEVER_RELEASED))
		{
			if (RAMN_SENSORS_POWERTRAIN.shift_lever == RAMN_LEVER_UP)
			{
				RAMN_SENSORS_POWERTRAIN.gear = ((RAMN_SENSORS_POWERTRAIN.gear < MAX_GEAR_VALUE) || (RAMN_SENSORS_POWERTRAIN.gear == 0xFF)) ? (((uint8_t)RAMN_SENSORS_POWERTRAIN.gear)+1)&0xFF : RAMN_SENSORS_POWERTRAIN.gear;
			}
			if (RAMN_SENSORS_POWERTRAIN.shift_lever == RAMN_LEVER_DOWN)
			{
				RAMN_SENSORS_POWERTRAIN.gear = (RAMN_SENSORS_POWERTRAIN.gear <= MAX_GEAR_VALUE) ? (((uint8_t)RAMN_SENSORS_POWERTRAIN.gear)-1)&0xFF : RAMN_SENSORS_POWERTRAIN.gear;
			}

			if (RAMN_SENSORS_POWERTRAIN.shift_lever == RAMN_LEVER_RIGHT)  RAMN_SENSORS_POWERTRAIN.turnIndicatorRequest = (RAMN_SENSORS_POWERTRAIN.turnIndicatorRequest ^ 0x1)&0xFF;
			if (RAMN_SENSORS_POWERTRAIN.shift_lever == RAMN_LEVER_LEFT)   RAMN_SENSORS_POWERTRAIN.turnIndicatorRequest = (RAMN_SENSORS_POWERTRAIN.turnIndicatorRequest ^ 0x100)&0xFF00;
		}
		RAMN_SENSORS_POWERTRAIN_PREVIOUS = RAMN_SENSORS_POWERTRAIN;
	}

	if (RAMN_SENSORS_POWERTRAIN.shift_lever == RAMN_LEVER_PUSH) RAMN_SENSORS_POWERTRAIN.hornRequest = True;
	else RAMN_SENSORS_POWERTRAIN.hornRequest = False;

}
#endif

#if defined(EXPANSION_CHASSIS)

//variable to keep the tick of the last update.
static uint32_t last_update_tick = 0U;

RAMN_SENSORS_ChassisSensors_t RAMN_SENSORS_CHASSIS = {
		.steering_wheel = 0x7FF,
		.sidebrake_switch = RAMN_SIDEBRAKE_UNKNOWN,
		.lights_switch = RAMN_LIGHTSWITCH_FLOATING
};

static RAMN_LightSwitchState_t convertLightSwitchADC(uint16_t adcval)
{
	RAMN_LeverState_t         result = RAMN_LIGHTSWITCH_UNKNOWNSTATE;
	if      (adcval >= 0x0B00)  result = RAMN_LIGHTSWITCH_POS1;
	else if (adcval >= 0x0700)  result = RAMN_LIGHTSWITCH_POS2;
	else if (adcval >= 0x0300)  result = RAMN_LIGHTSWITCH_POS3;
	else if (adcval <= 0x0100)  result = RAMN_LIGHTSWITCH_POS4;
	return result;
}

static RAMN_SideBrakeState_t convertSideBrakeADC(uint16_t adcval)
{
	if (adcval < 0x700) return RAMN_SIDEBRAKE_DOWN;
	else return RAMN_SIDEBRAKE_UP;
}

#define CHASSIS_LOGARITHMIC_POTENTIOMETER
#if defined (CHASSIS_LOGARITHMIC_POTENTIOMETER)
static uint16_t loglookupt[] = {
		0xfff, 0xfff, 0xfff, 0xfff, 0xfff, 0xfff, 0xfff, 0xfff, 0xfff, 0xfff, 0xfff, 0xfff,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 0x0,
};

static uint16_t logToLinear(uint16_t val ) {
	return loglookupt[val];
}

#endif

static void updateChassis(uint32_t tick)
{
	RAMN_LightSwitchState_t currentLightButton;
#ifdef CHASSIS_LOGARITHMIC_POTENTIOMETER
	RAMN_SENSORS_CHASSIS.steering_wheel = logToLinear(RAMN_SENSORS_ADCValues[0]);
#else
	RAMN_SENSORS_CHASSIS.steering_wheel = (0xFFF-RAMN_SENSORS_ADCValues[0]);
#endif
	RAMN_SENSORS_CHASSIS.sidebrake_switch = convertSideBrakeADC(RAMN_SENSORS_ADCValues[1]);

	currentLightButton = convertLightSwitchADC(RAMN_SENSORS_ADCValues[2]);

	//Update the value as little as possible to avoid flicker
	if (currentLightButton != RAMN_SENSORS_CHASSIS.lights_switch)
	{
		if (tick - last_update_tick > 250U)
		{
			last_update_tick = tick;
			RAMN_SENSORS_CHASSIS.lights_switch = currentLightButton;
		}
	}
	else
	{
		last_update_tick = tick;
		RAMN_SENSORS_CHASSIS.lights_switch = currentLightButton;
	}
}
#endif

#if defined(EXPANSION_BODY)
RAMN_SENSORS_BodySensors_t RAMN_SENSORS_BODY_PREVIOUS;
RAMN_SENSORS_BodySensors_t RAMN_SENSORS_BODY = {
		.engine_key = RAMN_ENGINEKEY_FLOATING
};

static RAMN_EngineKeyState_t convertEngineKeyADC(uint16_t adcval)
{
	if (adcval <= 0x300) return RAMN_ENGINEKEY_LEFT;
	else if (adcval <= 0xA00) return RAMN_ENGINEKEY_MIDDLE;
	else return RAMN_ENGINEKEY_RIGHT;
}

static void updateBody(uint32_t tick)
{
	RAMN_SENSORS_BODY.engine_key =convertEngineKeyADC(RAMN_SENSORS_ADCValues[1]);
}
#endif



//Exported --------------------------------------------

#if defined(EXPANSION_CHASSIS) || defined(EXPANSION_POWERTRAIN) || defined(EXPANSION_BODY)
uint16_t RAMN_SENSORS_ADCValues[NUMBER_OF_ADC] = {0,0,0};
#endif

void RAMN_SENSORS_Init(void)
{

}

void RAMN_SENSORS_Update(uint32_t tick)
{

#if defined(EXPANSION_POWERTRAIN)
	updatePowertrain(tick);
#endif

#if defined(EXPANSION_CHASSIS)
	updateChassis(tick);
#endif

#if defined(EXPANSION_BODY)
	RAMN_SENSORS_BODY_PREVIOUS = RAMN_SENSORS_BODY;
	updateBody(tick);
#endif

}



