/*
 * ramn_chip8.c
 ******************************************************************************
 * @attention
 *
 * <h2><center>&copy; Copyright (c) 2024 TOYOTA MOTOR CORPORATION.
 * ALL RIGHTS RESERVED.</center></h2>
 *
 * This software component is licensed by TOYOTA MOTOR CORPORATION under BSD 3-Clause license,
 * the "License"; You may not use this file except in compliance with the
 * License. You may obtain a copy of the License at:
 *                        opensource.org/licenses/BSD-3-Clause
 *
 ******************************************************************************
 */

#include "ramn_chip8.h"
#include "ramn_dbc.h"

#ifdef ENABLE_SCREEN


/*
0x000-0x1FF - Reserved area (contains fonts, etc.)
0x200-0xFFF - Actual game memory
 */
static uint16_t opcode; //Current opcode
static uint8_t memory[0x1000+0x210]; //Interpreter memory
static uint8_t V[16]; //Sixteen working registers
static uint8_t RPL[8]; //RPL registers (for super chip)
static uint16_t I; //Memory pointer
static uint16_t PC; //Program Counter


uint16_t stack[32]; //Stack of interpreter
uint16_t SP; //Stack Pointer
uint16_t key[16] = {0}; // Status of each Key. Note that some keys are ignored or redundant since RAMN does not feature 16 keys.
uint8_t delay_timer;
uint8_t sound_timer;

uint8_t key_waiting_release = 0xFF;

uint8_t screen_start_x = 24;
uint8_t screen_start_y = 46;
uint8_t pixel_size = DEFAULT_PIXEL_SIZE;
uint8_t screen_width = 64;
uint8_t screen_height = 32;
uint8_t extended = 0U;

uint8_t screen_buffer[MAX_SCREEN_WIDTH * MAX_SCREEN_HEIGHT] __attribute__ ((section (".buffers")));
uint16_t sprite_buffer[16*16*3*3] __attribute__ ((section (".buffers")));
uint16_t large_sprite_buffer[64*32*3*3] __attribute__ ((section (".buffers")));

uint16_t back_color = COLOR_BLACK;
uint16_t front_color = COLOR_WHITE;

uint8_t chip8_screen_initialized = 0U;
uint8_t game_started = 0U;
uint32_t lastTimerUpdate = 0;

unsigned const char chip8_font[240] =
{
		// Low Resolution
		0xF0, 0x90, 0x90, 0x90, 0xF0, // 0
		0x20, 0x60, 0x20, 0x20, 0x70, // 1
		0xF0, 0x10, 0xF0, 0x80, 0xF0, // 2
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		0xF0, 0x80, 0xF0, 0x80, 0x80,  // F

		// High Resolution
		0x3C, 0x7E, 0xE7, 0xC3, 0xC3, 0xC3, 0xC3, 0xE7, 0x7E, 0x3C,
		0x18, 0x38, 0x58, 0x18, 0x18, 0x18, 0x18, 0x18, 0x18, 0x3C,
		0x3E, 0x7F, 0xC3, 0x06, 0x0C, 0x18, 0x30, 0x60, 0xFF, 0xFF,
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		0x3C, 0x7E, 0xC3, 0xC3, 0x7F, 0x3F, 0x03, 0x03, 0x3E, 0x7C
};

//Example games from https://github.com/JohnEarnest/chip8Archive

//Cave Explorer
const uint8_t cave_explorer[] = {0x1e,0xa5,0x20,0x20,0x20,0x00,0x20,0xf0,0x10,0x70,0x00,0x40,0xe0,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0xcb,};

//Danm8ku
const uint8_t danmaku[] = {0x14,0xe2,0xe0,0x00,0x80,0x79,0x00,0x60,0x0c,0x0c,0x3e,0x0c,0x9b,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0x11,};

//Octopeg
const uint8_t octopeg[] = {0x1c,0x16,0x22,0x0a,0x62,0x80,0x22,0x28,0x00,0xee,0x60,0xad,0x61,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0xff,};


//TODO: optimize
static void redrawScreen()
{

	uint16_t color;
	for (uint16_t xline = 0; xline < screen_width; xline++)
	{
		for(uint16_t yline = 0; yline < screen_height; yline++)
		{
			color = (screen_buffer[(((xline)) + (((yline)) * screen_width))] == 0) ? back_color : front_color;
			for(uint8_t px = 0; px < pixel_size; px++)
			{
				for(uint8_t py = 0; py < pixel_size; py++)
				{
					large_sprite_buffer[(xline*pixel_size+px) + (yline*pixel_size+py)*(screen_width*pixel_size)] = color;
				}
			}
		}
	}
	RAMN_SPI_DrawImage(screen_start_x, screen_start_y, pixel_size*screen_width, pixel_size*screen_height, large_sprite_buffer);

}

static void scrollUpByNPixels(uint8_t n)
{
	for (int x = 0; x < screen_width; x++) {

		for (int y = n; y < screen_height; y++) {
			int current_pixel_index = x + y * screen_width;
			int next_pixel_index = (x) + (y-n) * screen_width;

			screen_buffer[next_pixel_index] = screen_buffer[current_pixel_index];
		}

		// Fill the rightmost 4 pixels with 0
		for (int y = screen_height - n; y < screen_width; y++) {
			int current_pixel_index = x + y * screen_width;
			screen_buffer[current_pixel_index] = 0;
		}
	}
}

static void scrollDownByNPixels(uint8_t n)
{
	for (int x = 0; x < screen_width; x++) {

		for (int y = screen_height-n-1; y >= 0 ; y--) {
			int current_pixel_index = x + y * screen_width;
			int next_pixel_index = (x) + (y+n) * screen_width;

			screen_buffer[next_pixel_index] = screen_buffer[current_pixel_index];
		}

		// Fill the rightmost 4 pixels with 0
		for (int y = 0; y < n; y++) {
			int current_pixel_index = x + y * screen_width;
			screen_buffer[current_pixel_index] = 0;
		}
	}
}

static void scrollLeftBy4Pixels() {
	uint8_t n = 4;
	if (extended == 0U) n = 2;
	for (int y = 0; y < screen_height; y++) {
		for (int x = 0; x < screen_width - n; x++) {
			int current_pixel_index = x + y * screen_width;
			int next_pixel_index = (x + n) + y * screen_width;

			screen_buffer[current_pixel_index] = screen_buffer[next_pixel_index];
		}

		// Fill the rightmost 4 pixels with 0
		for (int x = screen_width - n; x < screen_width; x++) {
			int current_pixel_index = x + y * screen_width;
			screen_buffer[current_pixel_index] = 0;
		}
	}
}

static void scrollRightBy4Pixels() {
	uint8_t n = 4;
	if (extended == 0U) n = 2;

	for (int y = 0; y < screen_height; y++) {
		for (int x = screen_width-1; x >= n; x--) {
			int current_pixel_index = x + y * screen_width;
			int next_pixel_index = (x - n) + y * screen_width;

			screen_buffer[current_pixel_index] = screen_buffer[next_pixel_index];
		}

		// Fill the left 4 pixels with 0
		for (int x = 0; x < n; x++) {
			int current_pixel_index = x + y * screen_width;
			screen_buffer[current_pixel_index] = 0;
		}
	}
}

void RAMN_CHIP8_SetColor(uint16_t fg, uint16_t bg)
{
	front_color = fg;
	back_color = bg;
}

void RAMN_CHIP8_Init(const uint8_t* game_to_load, uint16_t game_size)
{
	PC     = 0x200;  // game location
	opcode = 0;
	I      = 0;
	SP     = 0;
	delay_timer = 0;
	sound_timer = 0; // Note that this is not implemented since there is no buzzer

	//Clear registers
	for(uint8_t i = 0; i < 0x10; i++)
		V[i] = 0;

	//Load font
	for(int i = 0; i < sizeof(chip8_font); ++i)
		memory[FONT_ADDRESS + i] = chip8_font[i];

	//Load game
	for(uint16_t i = 0; i < game_size; ++i)
		memory[0x200 + i] = game_to_load[i];


	//Clear RPL
	for (uint8_t i = 0; i < 8; i++)
	{
		RPL[i] = 0;
	}

	for(uint16_t i = 0x200 + game_size; i < sizeof(memory); ++i)
		memory[i] = 0;

	//clear screen
	chip8_screen_initialized = 0U;
	for(uint32_t i = 0; i < sizeof(screen_buffer); i++) screen_buffer[i] = 0;

	for(uint32_t i = 0; i < 16*16*3*3; i++) sprite_buffer[i] = back_color;

	//Verify that we are in chip 8 mode
	pixel_size = DEFAULT_PIXEL_SIZE;
	extended = 0U;
	screen_start_x = 24;
	screen_start_y = 46;
	screen_width = 64;
	screen_height = 32;
}


uint8_t RAMN_CHIP8_IsGameActive()
{
	return game_started;
}

void RAMN_CHIP8_StartGame(uint32_t xLastWakeTime)
{
	lastTimerUpdate = xLastWakeTime;
	game_started = 1U;
}

void RAMN_CHIP8_StopGame()
{
	game_started = 0U;
}

void RAMN_CHIP8_InitFromIndex(uint8_t index)
{
	game_started = 0U;
	osDelay(200); //leave some time to quit the game (TODO optimize this)
	switch(index){
	case 0x01:
		RAMN_CHIP8_Init(danmaku, sizeof(danmaku));
		RAMN_CHIP8_StartGame(xTaskGetTickCount());
		break;
	case 0x02:
		RAMN_CHIP8_Init(cave_explorer, sizeof(cave_explorer));
		RAMN_CHIP8_StartGame(xTaskGetTickCount());
		break;
	case 0x03:
		RAMN_CHIP8_Init(octopeg, sizeof(octopeg));
		RAMN_CHIP8_StartGame(xTaskGetTickCount());
		break;
	default:
		break;
	}
}


uint8_t RAMN_CHIP8_Update(uint32_t xLastWakeTime)
{
	uint8_t X;
	uint8_t Y;
	uint8_t CARRY;

	for(uint8_t i=0; i < 16; i++)
	{
		key[i] = 0x00;
	}
	switch((RAMN_DBC_Handle.control_shift >> 8))
	{
	case 0x02:
		//up
		key[0x5] = 0xFF;
		break;
	case 0x03:
		//down
		key[0x08] = 0xFF;
		break;
	case 0x04:
		//right
		key[0x09] = 0xFF;
		break;
	case 0x05:
		//left
		key[0x7] = 0xFF;
		break;
	case 0x06:
		//center
		key[0x6] = 0xFF; //redundant with UP
		break;
	}

	if (xLastWakeTime - lastTimerUpdate > 16)
	{
		if (sound_timer > 0) sound_timer -= 1;
		if (delay_timer > 0) delay_timer -= 1;
		lastTimerUpdate = xLastWakeTime;
	}

	if (PC >= sizeof(memory) || (I >= sizeof(memory))) // PC or I overflow
	{
		game_started = 0U;
		return;
	}
	opcode = memory[PC] << 8 | memory[PC + 1];

	switch (opcode & 0xF000)
	{
	case 0x0000:
		switch (opcode & 0x00FF)
		{
		case 0x0001:
			//Consider Noop
			PC += 2;
			break;
		case 0x00E0:
			for(uint32_t i = 0; i < MAX_SCREEN_WIDTH*MAX_SCREEN_HEIGHT; i++) screen_buffer[i] = 0;
			RAMN_SPI_DrawRectangle(screen_start_x, screen_start_y, screen_width*pixel_size, screen_height*pixel_size, back_color);
			PC += 2;
			break;
		case 0x00EE:
			SP -= 1;
			if (SP >= sizeof(stack)) //if an underflow happened, quit
			{
				game_started = 0U;
			}
			PC = stack[SP];
			PC += 2;
			break;
		case 0x00FB:
			scrollRightBy4Pixels();
			redrawScreen();
			PC += 2;
			break;
		case 0x00FC:
			scrollLeftBy4Pixels();
			redrawScreen();
			PC += 2;
			break;
		case 0x00FD:
			game_started = 0U;
			break;
		case 0x00FE:
			pixel_size = DEFAULT_PIXEL_SIZE;
			extended = 0U;
			screen_start_x = 24;
			screen_start_y = 46;
			screen_width = 64;
			screen_height = 32;
			PC += 2;
			chip8_screen_initialized = 0U; //redraw
			break;
		case 0x00FF:
			pixel_size = 1;
			screen_start_x = 56;
			screen_start_y = 64;
			screen_width = 128;
			screen_height = 64;
			extended = 1U;
			PC += 2;
			chip8_screen_initialized = 0U; //redraw
			break;
		default:
			switch (opcode & 0x00F0)
			{
			case 0x00D0:
				scrollUpByNPixels(opcode&0xF);
				redrawScreen();
				PC += 2;
				break;
			case 0x00C0:
				scrollDownByNPixels(opcode&0xF);
				redrawScreen();
				PC += 2;
				break;
			default:
				game_started = 0U;
			}
		}
		break;

		case 0x1000:
			PC = opcode & 0x0FFF;
			break;
		case 0x2000:
			stack[SP] = PC;
			SP++;  // incrementing the SP
			if (SP >= sizeof(stack))
			{
				game_started = 0U;
			}
			PC = opcode & 0x0FFF;
			break;
		case 0x3000:
			//0x3XNN SKIP NEXT IF VX EQUALS NN
			if (V[(opcode & 0x0F00) >> 8] == (opcode & 0x00FF))
				PC += 2;
			PC += 2;
			break;
		case 0x4000:
			//0x4XNN SKIP NEXT IF VX NOT EQUALS NN
			if (V[(opcode & 0x0F00) >> 8] != (opcode & 0x00FF))
				PC += 2;
			PC += 2;
			break;
		case 0x5000:
			//0xXY0 SKIP NEXT IF VX EQUALS VY
			if (V[(opcode & 0x0F00) >> 8] == V[(opcode & 0x00F0) >> 4])
				PC += 2;
			PC += 2;
			break;
		case 0x6000:
			//0x6XNN SET VX TO NN
			V[(opcode & 0x0F00) >> 8] = opcode & 0x00FF;
			PC += 2;
			break;
		case 0x7000:
			//0x7XNN ADD NN TO VX
			V[(opcode & 0x0F00) >> 8] += (opcode & 0x00FF);
			PC += 2;
			break;
		case 0x8000:
			X = (opcode & 0xF00) >> 8;
			Y = (opcode & 0x00F0) >> 4;
			switch (opcode & 0x000F)
			{
			case 0x0000:
				V[(opcode & 0xF00) >> 8] = V[(opcode & 0x00F0) >> 4];
				PC += 2;
				break;
			case 0x0001:
				V[(opcode & 0xF00) >> 8] |= V[(opcode & 0x00F0) >> 4];
				PC += 2;
				break;
			case 0x0002:
				V[(opcode & 0xF00) >> 8] &= V[(opcode & 0x00F0) >> 4];
				PC += 2;
				break;
			case 0x0003:
				V[(opcode & 0x0F00) >> 8] ^= V[(opcode & 0x00F0) >> 4];
				PC += 2;
				break;
			case 0x0004:
				if (V[(opcode & 0x00F0) >> 4] > (0xFF - V[(opcode & 0x0F00) >> 8]))
					CARRY = 1; //carry
				else
					CARRY = 0;
				V[(opcode & 0x0F00) >> 8] += V[(opcode & 0x00F0) >> 4];
				V[0xF] = CARRY;
				PC += 2;
				break;
			case 0x0005:
				if (V[(opcode & 0x00F0) >> 4] > V[(opcode & 0x0F00) >> 8])
					CARRY = 0;
				else
					CARRY = 1;
				V[(opcode & 0x0F00) >> 8] -= V[(opcode & 0x00F0) >> 4];
				V[0xF] = CARRY;
				PC += 2;
				break;
			case 0x0006:
				CARRY = V[Y] & 0x1;
				V[X] = V[Y] >> 1;
				V[0xF] = CARRY;
				PC += 2;
				break;
			case 0x000E:
				CARRY = (V[Y] >> 7)&0x1;
				V[X] = V[Y] << 1;
				V[0xF] = CARRY;
				PC += 2;
				break;
			case 0x0007:
				if (V[(opcode & 0x0F00) >> 8] > V[(opcode & 0x00F0) >> 4])
					CARRY = 0;
				else
					CARRY = 1;
				V[(opcode & 0x0F00) >> 8] = V[(opcode & 0x00F0) >> 4] - V[(opcode & 0x0F00) >> 8];
				V[0xF] = CARRY;
				PC += 2;
				break;
			default:
				game_started = 0U;
			}
			break;
			case 0x9000:
				// 0x9XY0: SKIP IF NOT EQUAL
				if (V[(opcode & 0x0F00) >> 8] != V[(opcode & 0x00F0) >> 4])
					PC += 2;
				PC += 2;
				break;
			case 0xA000:
				// ANNN: SET I TO NNN
				I = opcode & 0x0FFF;
				PC += 2;
				break;
			case 0xB000:
				// BNNN: JUMP
				PC = (opcode & 0x0FFF) + V[0];
				break;
			case 0xC000:
				//GET RNG
				V[(opcode & 0x0F00) >> 8] = (RAMN_RNG_Pop8() & 0xFF) & (opcode & 0x00FF);
				PC += 2;
				break;
			case 0xD000:
			{
				uint16_t x = V[(opcode & 0x0F00) >> 8];
				uint16_t y = V[(opcode & 0x00F0) >> 4];
				uint16_t height = opcode & 0x000F;
				uint16_t pixels;
				uint8_t wrapping = 0;
				uint8_t width = 8;
				V[0xF] = 0;

				if (chip8_screen_initialized == 0)
				{
					RAMN_SPI_DrawRectangle(screen_start_x, screen_start_y, screen_width*pixel_size, screen_height*pixel_size, back_color);
					chip8_screen_initialized = 1U;
				}

				if (height == 0)
				{
					if  (extended != 0U)
					{
						height = 16;
						width = 16;
					}
					else
					{
						height = 16;
						width = 16;
					}
				}
				uint16_t shift_mask = 0x80;
				uint8_t redraw_needed = 0U;
				wrapping = x+width > screen_width || y+height > screen_height;
				for (uint16_t yline = 0; yline < height; yline++)
				{
					uint16_t color;
					if (height == 16)
					{
						shift_mask = 0x8000;
						pixels = memory[I + yline*2] << 8;
						pixels |= memory[I + yline*2+1];
					}
					else
					{
						shift_mask = 0x80;
						pixels = memory[I + yline];
					}
					for (uint16_t xline = 0; xline < width; xline++)
					{
						uint8_t pixel = (pixels & (shift_mask >> xline)) != 0 ? 1U : 0U;

						if (pixel != 0)
						{
							redraw_needed = 1U;
							if (screen_buffer[(((x + xline)%screen_width) + (((y + yline)%screen_height) * screen_width))] != 0)
							{
								V[0xF] = 1;
							}
							screen_buffer[(((x + xline)%screen_width) + (((y + yline)%screen_height) * screen_width))] ^= pixel;

							//if there is a screen wrap, we draw pixel by pixel
							if (wrapping != 0)
							{
								color = (screen_buffer[(((x + xline)%screen_width) + (((y + yline)%screen_height) * screen_width))] == 0) ? back_color : front_color;
								RAMN_SPI_DrawRectangle(screen_start_x + ((x + xline)%screen_width)*pixel_size, screen_start_y + ((y + yline)%screen_height)*pixel_size, pixel_size, pixel_size, color);
							}

						}
						if (wrapping == 0)
						{
							color = (screen_buffer[(((x + xline)%screen_width) + (((y + yline)%screen_height) * screen_width))] == 0) ? back_color : front_color;
							for(uint8_t px = 0; px < pixel_size; px++)
							{
								for(uint8_t py = 0; py < pixel_size; py++)
								{
									sprite_buffer[(xline*pixel_size+px) + (yline*pixel_size+py)*(width*pixel_size)] = color;
								}
							}
						}
					}
				}
				//redraw if sprite change, and we haven't redrawn previously
				if (redraw_needed && (wrapping == 0U))
				{
					RAMN_SPI_DrawImage(screen_start_x + (x%screen_width)*pixel_size,screen_start_y + ((y)%screen_height)*pixel_size, pixel_size*width, pixel_size*height, sprite_buffer);
				}
				PC += 2;

			}
			break;

			case 0xE000:
				switch (opcode & 0x00FF)
				{
				case 0x009E:
					if (key[V[(opcode & 0x0F00) >> 8]] != 0)
						PC += 4;
					else
						PC += 2;
					break;
				case 0x00A1:
					if (key[V[(opcode & 0x0F00) >> 8]] == 0)
						PC += 4;
					else
						PC += 2;
					break;
				default:
					game_started = 0U;
				}
				break;
				case 0xF000:
					switch (opcode & 0x00FF)
					{
					case 0x0007:
						V[(opcode & 0x0F00) >> 8] = delay_timer;
						PC += 2;
						break;
					case 0x000A:
					{
						//TODO fix implementation, not standard now, but good enough for most games
						if (key_waiting_release == 0xFF)
						{
							for (uint8_t i = 0; i < 16; i++)
							{
								if (key[i] != 0)
								{
									key_waiting_release = i;
									break;
								}
							}
						}
						else
						{
							//Wait for key in V
							if (key[key_waiting_release] == 0)
							{
								V[(opcode & 0x0F00) >> 8] = key_waiting_release;
								PC += 2;
								key_waiting_release = 0xFF;
							}
						}
					}
					break;
					case 0x0015:
						delay_timer = V[(opcode & 0x0F00) >> 8];
						PC += 2;
						break;
					case 0x0018:
						sound_timer = V[(opcode & 0x0F00) >> 8];
						PC += 2;
						break;
					case 0x001E:
						I += V[(opcode & 0x0F00) >> 8];
						PC += 2;
						break;
					case 0x0029:
						I = FONT_ADDRESS + V[(opcode & 0x0F00) >> 8] * 0x5;
						PC += 2;
						break;
					case 0x0030:
						I = FONT_ADDRESS + 80 + V[(opcode & 0x0F00) >> 8] * 10;
						PC += 2;
						break;
					case 0x0033:
						memory[I] = V[(opcode & 0x0F00) >> 8] / 100;
						memory[I + 1] = (V[(opcode & 0x0F00) >> 8] / 10) % 10;
						memory[I + 2] = (V[(opcode & 0x0F00) >> 8] % 100) % 10;
						PC += 2;
						break;
					case 0x0055:
						for (uint8_t i = 0; i <= ((opcode & 0x0F00) >> 8); i++)
							memory[I + i] = V[i];
						I += (1 + ((opcode & 0x0F00) >> 8));
						PC += 2;
						break;

					case 0x0065:
						for (uint8_t i = 0; i <= ((opcode & 0x0F00) >> 8); i++)
							V[i] = memory[I + i];
						I += (1 + ((opcode & 0x0F00) >> 8));
						PC += 2;
						break;

					case 0x0075:
						for (uint8_t i = 0; i <= ((opcode & 0x0F00) >> 8); i++)
						{
							RPL[i] = V[i];
						}
						PC += 2;
						break;
					case 0x0085:
						for (uint8_t i = 0; i <= ((opcode & 0x0F00) >> 8); i++)
						{
							V[i] = RPL[i];
						}
						PC += 2;
						break;
					default:
						game_started = 0U;
					}
					break;
					default:
						game_started = 0U;
	}

}

#endif
